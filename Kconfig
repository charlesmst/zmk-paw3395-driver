## Kconfig
```kconfig
# Sensor data simulator
#
# Copyright (c) 2019 Nordic Semiconductor
#
# SPDX-License-Identifier: LicenseRef-Nordic-5-Clause
#

menuconfig PAW3395
  bool "PAW3395 mouse optical sensor"
  imply SETTINGS
  select SPI
  depends on INPUT
  depends on DT_HAS_PIXART_PAW3395_ENABLED
  help
      Enable PAW3395 mouse optical sensor.

if PAW3395

config INPUT_PAW3395_INIT_PRIORITY
    int "PAW3395 initialization priority"
    default INPUT_INIT_PRIORITY

config REPORT_ATTR
  bool "Enable attribute reporting feature"
  default y
  help
    Enable this option to report attribute value for led indication.
    
config PAW3395_SWAP_XY
  bool "Swap the X/Y axis of PAW3395 sensor"

config PAW3395_INVERT_X
  bool "Invert the X axis of PAW3395 sensor"

config PAW3395_INVERT_Y
  bool "Invert the Y axis of PAW3395 sensor"

config PAW3395_INIT_POWER_UP_EXTRA_DELAY_MS
  int "Extra power up init delay (ms)"
  default 0
  help
    Default minimum init power up delay is 10ms.
    Use this config to postpone init power up sequence if needs longer bootup time.

config PAW3395_IGNORE_FIRST_N
  int "Ignore first N data points"
  default 8
  help
    Ignore first N data points after initialization to prevent cursor jump.

config PAW3395_CALIBRATION_TIMEOUT_MS
  int "Manual calibration timeout"
  default 10000

config PAW3395_REPORT_INTERVAL_MIN
	int "PAW3395's default minimum report rate"
	default 0
	help
	  Default minimum report interval in milliseconds (startup default).
	  Can be changed at runtime via PAW3395_ATTR_REPORT_INTERVAL_MS.
	  0 = no rate limit; 8 = 120 Hz; 4 = 250 Hz; 1 = 1000 Hz.

config PAW3395_RATE_CYCLE_GPIO
    bool "PAW3395 hardware rate-cycle GPIO button"
    default n
    help
      Enable a dedicated GPIO button that directly cycles the PAW3395 report
      interval on the peripheral side (no central/keymap involvement).
      Configure rate-cycle-gpios and optionally rate-cycle-rates-ms in the
      sensor DTS node.

config PAW3395_REPORT_RATE_CYCLE
    bool "PAW3395 report-rate cycle behavior"
    default y
    depends on ZMK_BEHAVIOR_METADATA || !ZMK_BEHAVIOR_METADATA
    depends on DT_HAS_ZMK_BEHAVIOR_PAW3395_REPORT_RATE_CYCLE_ENABLED
    help
      Enables a ZMK key behavior that cycles the PAW3395 report interval
      through a user-defined list of millisecond values on each press.

module = PAW3395
module-str = PAW3395
source "${ZEPHYR_BASE}/subsys/logging/Kconfig.template.log_config"

endif #PAW3395
```

## dts/bindings/behaviors/zmk,behavior-paw3395-report-rate-cycle.yaml
```yaml
# Copyright (c) 2025 The ZMK Contributors
# SPDX-License-Identifier: MIT

description: |
  Cycles the PAW3395 sensor's runtime report interval on each key press.
  Define preset intervals in milliseconds; the behavior advances through
  them in order, wrapping around. Useful for toggling between 120 Hz (8 ms),
  250 Hz (4 ms), and 1000 Hz (1 ms) on a dedicated DPI/rate button.

  Example:
    paw3395_rrc: paw3395_rrc {
        compatible = "zmk,behavior-paw3395-report-rate-cycle";
        #binding-cells = <0>;
        sensor = <&mou0>;
        rates-ms = <8 4 1>;
    };

compatible: "zmk,behavior-paw3395-report-rate-cycle"

include: zero_param.yaml

properties:
  sensor:
    type: phandle
    required: true
    description: phandle to the PAW3395 sensor device node

  rates-ms:
    type: array
    required: true
    description: >
      Ordered list of report-interval values in milliseconds to cycle through.
      0 = no limit (unlimited rate).
```
